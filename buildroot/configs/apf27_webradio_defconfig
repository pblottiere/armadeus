## buildroot/package/armadeus/testsuite/Config.in
```kconfig
config BR2_PACKAGE_TESTSUITE
	bool "Armadeus Test Suite"
	help
	  Install Armadeus "Test Suite" (used for BSP release validation).
	  Test scripts will be installed on the APF in /usr/bin/test/.
```

## target/linux/modules/Kconfig
```kconfig
#
# Armadeus custom drivers configuration
#

menuconfig ARMADEUS_DRIVERS
	bool "Support for specific Armadeus drivers"
	---help---
	  This menu will give you access on some Armadeus drivers and tool.

if ARMADEUS_DRIVERS

comment "Misc."
source "drivers/armadeus/generic/Kconfig"
source "drivers/armadeus/as1531_platform/Kconfig"
source "drivers/armadeus/mxs_lradc/Kconfig"
source "drivers/armadeus/gpio/Kconfig"
source "drivers/armadeus/imxlkeypad/Kconfig"
source "drivers/armadeus/max1027/Kconfig"
source "drivers/armadeus/max9768/Kconfig"

comment "FPGA related"
source "drivers/armadeus/fpga/Kconfig"

comment "Handheld related"
source "drivers/armadeus/pwm/Kconfig"
source "drivers/armadeus/backlight/Kconfig"
source "drivers/armadeus/display/Kconfig"

comment "Communication bus related"
source "drivers/armadeus/isp1761/Kconfig"

endif # ARMADEUS_DRIVERS
```

## target/linux/modules/fpga/Kconfig
```kconfig
#
# Armadeus FPGA drivers configuration
#

menuconfig ARMADEUS_FPGA_DRIVERS
	bool "FPGA specific drivers and tools"
	---help---
	  All drivers and tools related to FPGA.

if ARMADEUS_FPGA_DRIVERS

source "drivers/armadeus/fpga/dev_tools/Kconfig"
source "drivers/armadeus/fpga/others/Kconfig"

comment "Specific designs"
source "drivers/armadeus/fpga/virtual_components/Kconfig"
source "drivers/armadeus/fpga/POD/Kconfig"
source "drivers/armadeus/fpga/board_designs/Kconfig"

endif # ARMADEUS_FPGA_DRIVERS
```

## target/linux/modules/fpga/POD/Kconfig
```kconfig
#
# Armadeus POD generated drivers configuration
#

config POD_DRIVERS
	boolean "Board drivers generated by POD"
	depends on ARMADEUS_FPGA_DRIVERS
	---help---
	  Makes all POD generated drivers selectable.

source "drivers/armadeus/fpga/POD/*/Kconfig"
```

## target/linux/modules/fpga/board_designs/Kconfig
```kconfig
#
# Armadeus FPGA platform drivers configuration
#

config ARMADEUS_FPGA_BOARD_DESIGNS
	boolean "Board designs"
	depends on ARMADEUS_FPGA_DRIVERS
	---help---
	  Board support for FPGA designs

source "drivers/armadeus/fpga/board_designs/*/Kconfig"
```

## target/linux/modules/fpga/board_designs/spvision_loader/Kconfig
```kconfig
config ARMADEUS_FPGA_BOARD_DESIGNS_SPVISION_PROBER
	tristate "board driver for sp_vision fpga loader"
	default n
	depends on ARMADEUS_FPGA_BOARD_DESIGNS
	select ARMADEUS_FPGA_VIRTUAL_SPVISION_LOADER
	select ARMADEUS_FPGA_VIRTUAL_COMPONENTS
	---help---
	  With this driver you will be able to load the configuration
	  of your sp_vision FPGA directly from Linux userspace.
```

## target/linux/modules/fpga/board_designs/twin_uart/Kconfig
```kconfig
config ARMADEUS_FPGA_BOARD_DESIGNS_TWIN_UARTS
	boolean "board drivers for twin uarts design"
	default n
	depends on ARMADEUS_FPGA_BOARD_DESIGNS && MACH_APF51
	select ARMADEUS_FPGA_VIRTUAL_COMPONENTS
	---help---
	  Board support for fpga designs twin uarts used
	  for gsm/gps on apf51Dev board.

source "drivers/armadeus/fpga/board_designs/twin_uart/uarts/Kconfig"
source "drivers/armadeus/fpga/board_designs/twin_uart/irq_mngr/Kconfig"
```
