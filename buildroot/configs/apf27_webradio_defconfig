## buildroot/configs/apf6mediacenter_defconfig
```kconfig
BR2_arm=y
BR2_cortex_a9=y
BR2_ARM_EABIHF=y
BR2_ARM_ENABLE_NEON=y
BR2_ARM_FPU_VFPV3D16=y
BR2_DL_DIR="$(BASE_DIR)/../downloads"
BR2_BACKUP_SITE="ftp://ftp2.armadeus.com/armadeusw/download"
BR2_CCACHE=y
BR2_CCACHE_DIR="$(TOPDIR)/.$(BR2_BOARD_NAME)-buildroot-ccache"
BR2_TOOLCHAIN_EXTERNAL=y
BR2_ENABLE_LOCALE_PURGE=y
BR2_TARGET_GENERIC_HOSTNAME="apf6"
BR2_TARGET_GENERIC_ISSUE="Welcome to Armadeus development platform !"
BR2_ROOTFS_SKELETON_CUSTOM=y
BR2_ROOTFS_SKELETON_CUSTOM_PATH="$(ARMADEUS_PATH)/rootfs/target_skeleton"
BR2_TARGET_GENERIC_GETTY_PORT="ttymxc3"
BR2_TARGET_TZ_INFO=y
BR2_TARGET_TZ_ZONELIST="europe"
BR2_TARGET_LOCALTIME="Europe/Paris"
BR2_ROOTFS_POST_BUILD_SCRIPT="$(ARMADEUS_PATH)/rootfs/post_build.sh"
BR2_ROOTFS_POST_IMAGE_SCRIPT="$(ARMADEUS_PATH)/rootfs/post_image_creation.sh"
BR2_ROOTFS_POST_SCRIPT_ARGS="apf6 imx6"
BR2_TARGET_ARMADEUS=y
BR2_BOARD_NAME="apf6"
BR2_CPU_NAME="imx6"
BR2_TARGET_ARMADEUS_NR_SDRAM="2"
BR2_TARGET_ARMADEUS_SDRAM_SIZE="512"
BR2_LINUX_KERNEL=y
BR2_LINUX_KERNEL_CUSTOM_GIT=y
BR2_LINUX_KERNEL_CUSTOM_REPO_URL="https://github.com/wandboard-org/linux.git"
BR2_LINUX_KERNEL_CUSTOM_REPO_VERSION="wandboard_imx_3.10.31_1.1.0_beta2"
BR2_LINUX_KERNEL_PATCH="../patches/linux/3.10.mx6_legacy"
BR2_LINUX_KERNEL_USE_CUSTOM_CONFIG=y
BR2_LINUX_KERNEL_CUSTOM_CONFIG_FILE="$(BR2_BOARD_PATH)/apf6legacy-linux-3.10.config"
BR2_LINUX_KERNEL_ZIMAGE=y
BR2_LINUX_KERNEL_DTS_SUPPORT=y
BR2_LINUX_KERNEL_INTREE_DTS_NAME="imx6q-apf6dev imx6dl-apf6dev imx6q-wandboard imx6dl-wandboard"
BR2_LINUX_KERNEL_INSTALL_TARGET=y
BR2_PACKAGE_BUSYBOX_CONFIG="$(ARMADEUS_PATH)/busybox.config"
BR2_PACKAGE_ALSA_UTILS=y
BR2_PACKAGE_ALSA_UTILS_AMIXER=y
BR2_PACKAGE_ALSA_UTILS_APLAY=y
BR2_PACKAGE_ALSA_UTILS_SPEAKER_TEST=y
BR2_PACKAGE_KODI=y
BR2_PACKAGE_KODI_ALSA_LIB=y
BR2_PACKAGE_KODI_LIBNFS=y
BR2_PACKAGE_PV=y
BR2_PACKAGE_DOSFSTOOLS=y
BR2_PACKAGE_DOSFSTOOLS_FATLABEL=y
BR2_PACKAGE_DOSFSTOOLS_FSCK_FAT=y
BR2_PACKAGE_DOSFSTOOLS_MKFS_FAT=y
BR2_PACKAGE_E2FSPROGS=y
BR2_PACKAGE_E2FSPROGS_E4DEFRAG=y
BR2_PACKAGE_E2FSPROGS_RESIZE2FS=y
BR2_PACKAGE_MMC_UTILS=y
BR2_PACKAGE_FBGRAB=y
BR2_PACKAGE_FB_TEST_APP=y
BR2_PACKAGE_FBTERM=y
BR2_PACKAGE_FBV=y
# BR2_PACKAGE_FBV_JPEG is not set
# BR2_PACKAGE_FBV_GIF is not set
BR2_PACKAGE_LINUX_FIRMWARE=y
BR2_PACKAGE_LINUX_FIRMWARE_TI_WL127X=y
BR2_PACKAGE_APF_CONFIG=y
BR2_PACKAGE_EVTEST=y
BR2_PACKAGE_FREESCALE_IMX_PLATFORM_IMX6Q=y
BR2_PACKAGE_FREESCALE_IMX_VERSION_3_10_31=y
BR2_PACKAGE_GPU_VIV_BIN_MX6Q=y
BR2_PACKAGE_I2C_TOOLS=y
BR2_PACKAGE_KBD=y
BR2_PACKAGE_PCI_DEBUG=y
BR2_PACKAGE_PCIUTILS=y
BR2_PACKAGE_TI_UTILS=y
BR2_PACKAGE_UBOOT_TOOLS=y
BR2_PACKAGE_TSLIB=y
BR2_PACKAGE_LIBFSLVPUWRAP=y
BR2_PACKAGE_NEWT=y
BR2_PACKAGE_BLUEZ_UTILS=y
BR2_PACKAGE_CAN_UTILS=y
BR2_PACKAGE_DROPBEAR=y
BR2_PACKAGE_IPERF=y
BR2_PACKAGE_IW=y
BR2_PACKAGE_WIRELESS_TOOLS=y
BR2_PACKAGE_WPA_SUPPLICANT=y
BR2_PACKAGE_WPA_SUPPLICANT_CLI=y
BR2_PACKAGE_WPA_SUPPLICANT_PASSPHRASE=y
BR2_PACKAGE_UTIL_LINUX_BINARIES=y
BR2_PACKAGE_UTIL_LINUX_FSCK=y
BR2_PACKAGE_NANO=y
BR2_TARGET_ROOTFS_EXT2=y
BR2_TARGET_ROOTFS_EXT2_4=y
BR2_TARGET_ROOTFS_EXT2_LABEL="ROOTFS"
BR2_TARGET_UBOOT=y
BR2_TARGET_UBOOT_BOARDNAME="$(BR2_BOARD_NAME)"
BR2_TARGET_UBOOT_CUSTOM_VERSION=y
BR2_TARGET_UBOOT_CUSTOM_VERSION_VALUE="2014.07"
BR2_TARGET_UBOOT_CUSTOM_PATCH_DIR="../patches/u-boot/2014.07"
BR2_TARGET_UBOOT_USE_CUSTOM_CONFIG=y
BR2_TARGET_UBOOT_CUSTOM_CONFIG_FILE="$(BR2_BOARD_PATH)/$(BR2_BOARD_NAME)-u-boot-2014.07.h"
BR2_TARGET_UBOOT_FORMAT_IMG=y
BR2_TARGET_UBOOT_SPL=y
BR2_TARGET_UBOOT_SPL_NAME="SPL"
BR2_PACKAGE_HOST_E2TOOLS=y
BR2_PACKAGE_HOST_GENIMAGE=y
BR2_PACKAGE_HOST_IMX_USB_LOADER=y
```

## buildroot/configs/pps51_defconfig
```kconfig
BR2_arm=y
BR2_cortex_a8=y
BR2_WGET="wget --passive-ftp --tries=3"
BR2_DL_DIR="$(BASE_DIR)/../downloads"
BR2_BACKUP_SITE="ftp://ftp2.armadeus.com/armadeusw/download"
BR2_CCACHE=y
BR2_CCACHE_DIR="$(TOPDIR)/.$(BR2_BOARD_NAME)-buildroot-ccache"
BR2_STRIP_sstrip=y
BR2_OPTIMIZE_2=y
BR2_KERNEL_HEADERS_VERSION=y
BR2_DEFAULT_KERNEL_VERSION="2.6.38.8"
BR2_UCLIBC_CONFIG="target/device/armadeus/uClibc-$(BR2_UCLIBC_VERSION_STRING).config"
BR2_TOOLCHAIN_BUILDROOT_LARGEFILE=y
BR2_TOOLCHAIN_BUILDROOT_INET_IPV6=y
BR2_TOOLCHAIN_BUILDROOT_INET_RPC=y
BR2_TOOLCHAIN_BUILDROOT_LOCALE=y
BR2_PTHREAD_DEBUG=y
BR2_BINUTILS_VERSION_2_23_2=y
BR2_TOOLCHAIN_BUILDROOT_CXX=y
BR2_PACKAGE_HOST_GDB=y
BR2_ENABLE_LOCALE_PURGE=y
BR2_ENABLE_LOCALE_WHITELIST="C en_US"
BR2_TARGET_OPTIMIZATION="-O2 -pipe"
BR2_TARGET_GENERIC_HOSTNAME="pps51"
BR2_TARGET_GENERIC_ISSUE="Welcome to Armadeus development platform !"
BR2_ROOTFS_DEVICE_CREATION_DYNAMIC_DEVTMPFS=y
BR2_ROOTFS_DEVICE_TABLE="$(ARMADEUS_PATH)/rootfs/device_table.txt"
BR2_ROOTFS_SKELETON_CUSTOM=y
BR2_ROOTFS_SKELETON_CUSTOM_PATH="$(ARMADEUS_PATH)/rootfs/target_skeleton"
BR2_TARGET_GENERIC_GETTY_PORT="ttymxc2"
BR2_ROOTFS_POST_BUILD_SCRIPT="$(ARMADEUS_PATH)/rootfs/post_build.sh"
BR2_ROOTFS_POST_IMAGE_SCRIPT="$(ARMADEUS_PATH)/rootfs/post_image_creation.sh"
BR2_ROOTFS_POST_SCRIPT_ARGS="pps51 imx51"
BR2_TARGET_ARMADEUS=y
BR2_BOARD_NAME="pps51"
BR2_CPU_NAME="imx51"
BR2_TARGET_ARMADEUS_SDRAM_SIZE="256"
BR2_LINUX_KERNEL=y
BR2_LINUX_KERNEL_CUSTOM_VERSION=y
BR2_LINUX_KERNEL_CUSTOM_VERSION_VALUE="2.6.38.8"
BR2_LINUX_KERNEL_PATCH="../patches/linux/$(BR2_LINUX_KERNEL_VERSION)"
BR2_LINUX_KERNEL_USE_CUSTOM_CONFIG=y
BR2_LINUX_KERNEL_CUSTOM_CONFIG_FILE="$(BR2_BOARD_PATH)/$(BR2_BOARD_NAME)-linux-$(BR2_LINUX_KERNEL_VERSION).config"
BR2_PACKAGE_BUSYBOX_CONFIG="$(ARMADEUS_PATH)/busybox.config"
BR2_PACKAGE_FPGAREGS=y
BR2_PACKAGE_FPGA_FIRMWARE=y
BR2_PACKAGE_FPGA_FIRMWARE_APF51_DUAL_UART=y
BR2_PACKAGE_IMXREGS=y
BR2_PACKAGE_TESTSUITE=y
BR2_PACKAGE_PPS=y
BR2_PACKAGE_PPS_TEST_SCRIPTS=y
BR2_PACKAGE_TFP410CTRL=y
BR2_PACKAGE_ALSA_UTILS=y
BR2_PACKAGE_ALSA_UTILS_AMIXER=y
BR2_PACKAGE_ALSA_UTILS_APLAY=y
BR2_PACKAGE_ALSA_UTILS_SPEAKER_TEST=y
BR2_PACKAGE_GDB=y
BR2_PACKAGE_STRACE=y
BR2_PACKAGE_FBTEST=y
BR2_PACKAGE_FBV=y
BR2_PACKAGE_MTD=y
BR2_PACKAGE_MTD_JFFS2DUMP=y
BR2_PACKAGE_MTD_MKFSJFFS2=y
BR2_PACKAGE_MTD_SUMTOOL=y
BR2_PACKAGE_LINUX_FIRMWARE=y
BR2_PACKAGE_LINUX_FIRMWARE_LIBERTAS_SD8686_V9=y
BR2_PACKAGE_DBUS=y
BR2_PACKAGE_I2C_TOOLS=y
BR2_PACKAGE_UBOOT_TOOLS=y
BR2_PACKAGE_OPENSSL_BIN=y
BR2_PACKAGE_OPENSSL_ENGINES=y
BR2_PACKAGE_TSLIB=y
BR2_PACKAGE_LIBXML2=y
BR2_PACKAGE_BLUEZ3_UTILS=y
BR2_PACKAGE_BOA=y
BR2_PACKAGE_BRIDGE_UTILS=y
BR2_PACKAGE_CAN_UTILS=y
BR2_PACKAGE_ETHTOOL=y
BR2_PACKAGE_IPROUTE2=y
BR2_PACKAGE_IPSEC_TOOLS=y
BR2_PACKAGE_IPSEC_TOOLS_NATT=y
BR2_PACKAGE_IPSEC_TOOLS_FRAG=y
BR2_PACKAGE_IPTABLES=y
BR2_PACKAGE_NTP=y
# BR2_PACKAGE_NTP_NTPD is not set
BR2_PACKAGE_OPENSSH=y
BR2_PACKAGE_PORTMAP=y
BR2_PACKAGE_PPPD=y
BR2_PACKAGE_UUCP=y
BR2_PACKAGE_WIRELESS_TOOLS=y
BR2_PACKAGE_WPA_SUPPLICANT=y
BR2_PACKAGE_WPA_SUPPLICANT_EAP=y
BR2_PACKAGE_WPA_SUPPLICANT_CLI=y
BR2_PACKAGE_WPA_SUPPLICANT_PASSPHRASE=y
BR2_PACKAGE_WPA_SUPPLICANT_AP_SUPPORT=y
BR2_PACKAGE_WPA_SUPPLICANT_WPS=y
BR2_PACKAGE_NANO=y
BR2_TARGET_ROOTFS_UBIFS=y
BR2_TARGET_ROOTFS_UBIFS_MAXLEBCNT=135301
BR2_TARGET_ROOTFS_UBI=y
BR2_TARGET_UBOOT=y
BR2_TARGET_UBOOT_BOARDNAME="apf51"
BR2_TARGET_UBOOT_CUSTOM_TARBALL=y
BR2_TARGET_UBOOT_CUSTOM_TARBALL_LOCATION="ftp://ftp.denx.de/pub/u-boot/u-boot-2014.04.tar.bz2"
BR2_TARGET_UBOOT_CUSTOM_PATCH_DIR="../patches/u-boot/2014.04"
BR2_TARGET_UBOOT_USE_CUSTOM_CONFIG=y
BR2_TARGET_UBOOT_CUSTOM_CONFIG_FILE="$(ARMADEUS_PATH)/apf51/apf51-u-boot-2014.04.h"
BR2_TARGET_UBOOT_FORMAT_CUSTOM=y
BR2_TARGET_UBOOT_FORMAT_CUSTOM_NAME="u-boot-with-nand-spl.imx"
BR2_TARGET_UBOOT_NETWORK=y
BR2_TARGET_UBOOT_SERVERIP="192.168.0.2"
BR2_TARGET_UBOOT_IPADDR="192.168.0.10"
BR2_TARGET_UBOOT_GATEWAY="192.168.0.1"
BR2_TARGET_UBOOT_ETHADDR=""
BR2_TARGET_UBOOT_ENVIMAGE=y
BR2_TARGET_UBOOT_ENVIMAGE_SOURCE="$(ARMADEUS_PATH)/u-boot-env-2013.04.txt"
BR2_TARGET_UBOOT_ENVIMAGE_SIZE="0x20000"
```

## buildroot/package/armadeus/Config.in
```kconfig
menu "Armadeus specific tools/utilities"

source package/armadeus/anybus-tools/Config.in
source package/armadeus/as_devices/Config.in
source package/armadeus/demos/Config.in
source package/armadeus/fpgaregs/Config.in
source package/armadeus/fpga_firmware/Config.in
source package/armadeus/imx28-usb-downloader/Config.in
source package/armadeus/imxregs/Config.in
source package/armadeus/imxssi/Config.in
source package/armadeus/max5821ctrl/Config.in
source package/armadeus/straton/Config.in
source package/armadeus/straton_ios/Config.in
source package/armadeus/testsuite/Config.in

comment "APF27 specific:"
source package/armadeus/ad9889ctrl/Config.in
source package/armadeus/pps/Config.in
comment "APF51 specific:"
source package/armadeus/tfp410ctrl/Config.in
comment "APF9328 specific:"
source package/armadeus/ch7024ctrl/Config.in

endmenu
```

## buildroot/package/armadeus/ad9889ctrl/Config.in
```kconfig
config BR2_PACKAGE_AD9889CTRL
	bool "ad9889ctrl"
	depends on BR2_TARGET_ARMADEUS
	help
	  Build "ad9889ctrl" tool. It allows you to configure the HDMI/DVI
	  output of the APF27DevFull directly from Linux userspace.
```

## buildroot/package/armadeus/anybus-tools/Config.in
```kconfig
config BR2_PACKAGE_ANYBUS_TOOLS
	bool "anybus-tools"
	depends on BR2_PACKAGE_NCURSES
	help
	  Tools for HMS module anybus.

comment "anybus-tools requires package ncurses"
	depends on !BR2_PACKAGE_NCURSES
```

## buildroot/package/armadeus/as_devices/Config.in
```kconfig
config BR2_PACKAGE_AS_DEVICES
	bool "as_devices"
	depends on BR2_TARGET_ARMADEUS
	help
          Library that drives armadeus specific devices.

config BR2_PACKAGE_AS_DEVICES_TESTS
	bool "as_devices test tool"
	depends on BR2_PACKAGE_AS_DEVICES
	help
	  Executable that can test all as_devices modules.

config BR2_PACKAGE_AS_DEVICES_CPP
	depends on BR2_PACKAGE_AS_DEVICES
	depends on BR2_INSTALL_LIBSTDCPP
	bool "C++ wrapper"
	help
	  C++ wrapper for as_devices library.

config BR2_PACKAGE_AS_DEVICES_TESTS_CPP
	bool "as_devices C++ wrapper test tool"
	depends on BR2_PACKAGE_AS_DEVICES_CPP
	help
	  Executable that can test as_devices C++ wrappers.

config BR2_PACKAGE_AS_DEVICES_PYTHON
	depends on BR2_PACKAGE_AS_DEVICES
	depends on BR2_PACKAGE_PYTHON
	bool "Python wrapper"
	help
	  Python wrapper for as_devices library. Needs python.

comment "C++ wrapper requires a toolchain with C++ support"
	depends on !BR2_TOOLCHAIN_BUILDROOT_CXX

comment "Python wrapper requires python interpreter"
	depends on BR2_PACKAGE_AS_DEVICES && !BR2_PACKAGE_PYTHON
```

## buildroot/package/armadeus/demos/Config.in
```kconfig
config BR2_PACKAGE_DEMOS
	bool "Armadeus misc demos"
	help
	  Install Armadeus miscallenous demos.

menu "Choose the demos to install"
	depends on BR2_PACKAGE_DEMOS

config BR2_PACKAGE_ARMADEUS_DEMOS_ARMANOID
	bool "Armanoid"
	select BR2_PACKAGE_SDL
	help
	  Small game to show SDL usage.

config BR2_PACKAGE_ARMADEUS_DEMOS_BACKLIGHT
	bool "Backlight control"
	select BR2_PACKAGE_SDL
	help
	  SDL tool to graphically adjust LCD backlight.

config BR2_PACKAGE_ARMADEUS_DEMOS_GPIO
	bool "GPIO test"

config BR2_PACKAGE_ARMADEUS_DEMOS_GPS
	bool "GPS frame decoding"
	help
	  Small tool to show how to read and decode NMEA frames
	  coming from a serial GPS.

config BR2_PACKAGE_ARMADEUS_DEMOS_INPUT
	bool "Input test"
	select BR2_PACKAGE_SDL
	help
	  Shows how to use user inputs (mouse, keyboard, touch) in SDL.

config BR2_PACKAGE_ARMADEUS_DEMOS_MUSIC_PLAYER
	bool "Music player"
	select BR2_PACKAGE_SDL
	select BR2_PACKAGE_SDL_TTF
	select BR2_PACKAGE_SDL_MIXER
	help
	  SDL based music player.

config BR2_PACKAGE_ARMADEUS_DEMOS_CAPTURE
	bool "Camera capture"
	select BR2_PACKAGE_SDL
	help
	  Capture and display camera (V4L) video stream.

config BR2_PACKAGE_ARMADEUS_DEMOS_CAPTURE_VPU
	bool "use VPU"
	depends on BR2_PACKAGE_ARMADEUS_DEMOS_CAPTURE
#	select FREESCALE_TOOLS
	help
	  Use i.MX27/i.MX51 VPU to encode stream in H.264

config BR2_PACKAGE_ARMADEUS_DEMOS_OSCILLO
	bool "Oscilloscope"
	help
	  MAX1027 data viewer "à la" oscilloscope. (Work in progress).

config BR2_PACKAGE_ARMADEUS_DEMOS_SHOW_IMAGE
	bool "Image viewer"
	select BR2_PACKAGE_SDL_IMAGE
	help
	  SDL based image viewer.

config BR2_PACKAGE_ARMADEUS_DEMOS_TEST_LCD
	bool "LCD test"
	select BR2_PACKAGE_SDL
	help
	  Test for LCD dead pixels. Needs SDL.

config BR2_PACKAGE_ARMADEUS_DEMOS_MCP25020
	bool "MCP25020 demo"
	depends on BR2_PACKAGE_IPROUTE2
	help
	  Test for CAN bus communication with MCP25020 (demo board).
	  Requires package iproute2.

comment "MCP25020 demo requires package iproute2"
	depends on !BR2_PACKAGE_IPROUTE2

config BR2_PACKAGE_ARMADEUS_DEMOS_SHM
	bool "Shared memory demo"
	help
	  Test for shared memory.

endmenu
```

## buildroot/package/armadeus/fpga_firmware/Config.in
```kconfig
config BR2_PACKAGE_FPGA_FIRMWARE
	bool "FPGA Firmware"
	help
	  Install some FPGA firmwares.

if BR2_PACKAGE_FPGA_FIRMWARE
choice
	prompt "Firmware(s) to install"
	default BR2_PACKAGE_FPGA_FIRMWARE_CUSTOM

config BR2_PACKAGE_FPGA_FIRMWARE_APF51_DUAL_UART
	bool "APF51 dual UARTs (GSM/GPS)"
	help
	  Required if your want to use GSM or GPS on the APF51Dev. Firmware
	  will be named /lib/firmware/fpga/apf51_gsm_gps_firmware.bin.

config BR2_PACKAGE_FPGA_FIRMWARE_CUSTOM
	bool "Custom list"
	help
	  Use one or more custom FPGA binary files. The FPGA binary files will
	  be installed in /lib/firmware/fpga/ on the target.

endchoice

config BR2_PACKAGE_FPGA_FIRMWARE_CUSTOM_FILE
	string "Firmware(s) path list"
	depends on BR2_PACKAGE_FPGA_FIRMWARE_CUSTOM
	help
	  Path list to your custom FPGA binary files to install.

config BR2_PACKAGE_FPGA_FIRMWARE_EXPORT
	bool "Export the FPGA firmware to Buildroot output/images/ folder"
	help
	  Build a link from Buildroot output/images/ folder to the FPGA
	  firmware.
	  This link will be named $(BOARD_NAME)-firmware.bin (default name
	  looked by U-Boot when asking for firmware update).

endif # BR2_PACKAGE_FPGA_FIRMWARE
```

## buildroot/package/armadeus/imx28-usb-downloader/Config.in
```kconfig
config BR2_PACKAGE_IMX28_USB_DOWNLOADER
	bool "imx28-usb-downloader (target)"
	help
	  Target tool to download i.MX28 binary through USB.

config BR2_PACKAGE_HOST_IMX28_USB_DOWNLOADER
	bool "imx28-usb-downloader (host)"
	help
	  Host tool to download i.MX28 binary through USB.
```

## buildroot/package/armadeus/pps/Config.in
```kconfig
config BR2_PACKAGE_PPS
	bool "PPS Utilities"
	help
	  Install PPS utilities & initialization scripts needed for:
	    - GPIOs initialization
	    - Guest user creation to connect to PPS via SSH

if BR2_PACKAGE_PPS

config BR2_PACKAGE_PPS_TEST_SCRIPTS
	bool "PPS Test scripts"
	help
	  Install PPS test scripts for Ethernet, WiFi & USB Gadget.
	  Scripts will be installed in /usr/local/pps/scripts.

endif
```

## buildroot/package/armadeus/straton/Config.in
```kconfig
comment "straton requires as_devices to be installed"
	depends on !(BR2_PACKAGE_AS_DEVICES)

config BR2_PACKAGE_STRATON
	bool "straton  IEC-61131-3 environment"
	default n
	depends on BR2_PACKAGE_AS_DEVICES

if BR2_PACKAGE_AS_DEVICES
choice
	prompt "Straton version"
	default BR2_PACKAGE_STRATON_DEMO
	depends on BR2_PACKAGE_STRATON

config BR2_PACKAGE_STRATON_DEV
	bool "straton_dev"
	help
	  Developpement code for straton plc application.
	  This code is not GPL then you have to ask
	  ARMadeus Systems to obtain it.

config BR2_PACKAGE_STRATON_BIN
	bool "straton_bin"
	help
	  Straton runtime binary. This runtime is not free
	  ask ARMadeus Systems to obtain it. If you have
	  the tar.gz, copy it under your downloads/ directory

config BR2_PACKAGE_STRATON_DEMO
	bool "straton_demo"
	help
	  Straton demo runtime. This runtime will be stopped
	  after 10 minutes running. It can be relaunched each
	  10 minutes.

endchoice

config BR2_PACKAGE_STRATON_DEV_DIR
	string "straton development directory"
	default "/straton/runtime"
	depends on BR2_PACKAGE_STRATON_DEV
	help
	  Straton runtime development code directory

endif
```

## buildroot/package/armadeus/straton_ios/Config.in
```kconfig
config BR2_PACKAGE_STRATON_IOS
	bool "straton_ios"
	depends on BR2_TARGET_ARMADEUS
	depends on BR2_PACKAGE_STRATON
	help
	  Library for straton i/o
```
