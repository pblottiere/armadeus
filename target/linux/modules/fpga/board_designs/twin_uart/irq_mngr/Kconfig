## target/linux/modules/fpga/board_designs/twin_uart/irq_mngr/Kconfig
```kconfig
config ARMADEUS_FPGA_BOARD_DESIGNS_TWIN_UARTS_IRQ_MNGR
	tristate "board irq manager"
	default n
	depends on ARMADEUS_FPGA_BOARD_DESIGNS_TWIN_UARTS
	select ARMADEUS_FPGA_VIRTUAL_COMPONENTS_IRQ_MNGR
	---help---
	  irq manager board 
```

## target/linux/modules/fpga/board_designs/twin_uart/uarts/Kconfig
```kconfig
config ARMADEUS_FPGA_BOARD_DESIGNS_TWIN_UARTS_UARTS
	tristate "board twin uarts"
	default n
	depends on ARMADEUS_FPGA_BOARD_DESIGNS_TWIN_UARTS
	select SERIAL_8250
	---help---
	  Board support for fpga designs twin uarts used
	  for gsm/gps on apf51Dev board.
		If selected as module, it will be named :
		twin_uarts_16750
```

## target/linux/modules/fpga/board_designs/wishbone_example/Kconfig
```kconfig
#
# Armadeus custom drivers configuration
                     
#
config ARMADEUS_FPGA_BOARD_DESIGNS_WISHBONE_EXAMPLE
	boolean "board drivers for wishbone example"
	default n
	depends on ARMADEUS_FPGA_BOARD_DESIGNS
	select ARMADEUS_FPGA_VIRTUAL_COMPONENTS
	---help---
	  Drivers used for wishbone example design that can be
	  found in firmware/wishbone_example/

source "drivers/armadeus/fpga/board_designs/wishbone_example/wb_button/Kconfig"
source "drivers/armadeus/fpga/board_designs/wishbone_example/wb_led/Kconfig"
source "drivers/armadeus/fpga/board_designs/wishbone_example/wb_irq_mngr/Kconfig"
```

## target/linux/modules/fpga/board_designs/wishbone_example/wb_button/Kconfig
```kconfig
#
#

config ARMADEUS_FPGA_BOARD_DESIGNS_WISHBONE_EXAMPLE_BUTTON_DRIVER
	tristate "board Button"
	default n
	depends on ARMADEUS_FPGA_BOARD_DESIGNS_WISHBONE_EXAMPLE
	select ARMADEUS_FPGA_VIRTUAL_COMPONENTS_BUTTON
	---help---
```

## target/linux/modules/fpga/board_designs/wishbone_example/wb_irq_mngr/Kconfig
```kconfig
#
# Armadeus custom drivers configuration
#
#

#
config ARMADEUS_FPGA_BOARD_DESIGNS_WISHBONE_EXAMPLE_IRQ_MNGR_DRIVER
	tristate "board irq"
	default n
	depends on ARMADEUS_FPGA_BOARD_DESIGNS_WISHBONE_EXAMPLE
	select ARMADEUS_FPGA_VIRTUAL_COMPONENTS_IRQ_MNGR
	---help---
```

## target/linux/modules/fpga/board_designs/wishbone_example/wb_led/Kconfig
```kconfig
config ARMADEUS_FPGA_BOARD_DESIGNS_WISHBONE_EXAMPLE_LED_DRIVER
	tristate "board Led"
	default n
	depends on ARMADEUS_FPGA_BOARD_DESIGNS_WISHBONE_EXAMPLE
	select ARMADEUS_FPGA_VIRTUAL_COMPONENTS_LED
	---help---
	  blink a led
```

## target/linux/modules/fpga/virtual_components/Kconfig
```kconfig
config ARMADEUS_FPGA_VIRTUAL_COMPONENTS
	boolean "virtual components"
	default y
	depends on ARMADEUS_FPGA_DRIVERS
	---help---
	  Armadeus driver specific for virtual components
	  under FPGA.

source "drivers/armadeus/fpga/virtual_components/irq_mngr/Kconfig"
source "drivers/armadeus/fpga/virtual_components/button/Kconfig"
source "drivers/armadeus/fpga/virtual_components/led/Kconfig"
source "drivers/armadeus/fpga/virtual_components/pod_gpio/Kconfig"
source "drivers/armadeus/fpga/virtual_components/pod_pwm/Kconfig"
source "drivers/armadeus/fpga/virtual_components/pod_servo/Kconfig"
source "drivers/armadeus/fpga/virtual_components/sploader/Kconfig"
```

## target/linux/modules/fpga/virtual_components/irq_mngr/Kconfig
```kconfig
config ARMADEUS_FPGA_VIRTUAL_COMPONENTS_IRQ_MNGR
	tristate "irq manager"
	default n
	depends on ARMADEUS_FPGA_VIRTUAL_COMPONENTS
	---help---
	  Armadeus driver for virtual irq_mngr component
```

## target/linux/modules/fpga/virtual_components/led/Kconfig
```kconfig
config ARMADEUS_FPGA_VIRTUAL_COMPONENTS_LED
	tristate "led"
	default n
	depends on ARMADEUS_FPGA_VIRTUAL_COMPONENTS
	---help---
	  Armadeus driver for virtual led component.
```

## target/linux/modules/fpga/virtual_components/pod_gpio/Kconfig
```kconfig
config ARMADEUS_FPGA_VIRTUAL_COMPONENTS_GPIO
	tristate "pod_gpio"
	default n
	depends on ARMADEUS_FPGA_VIRTUAL_COMPONENTS
	---help---
	  Armadeus driver for virtual pod_gpio component.
	  kernel >= 2.6.38 is required
```

## target/linux/modules/fpga/virtual_components/pod_pwm/Kconfig
```kconfig
config ARMADEUS_FPGA_VIRTUAL_COMPONENTS_PWM
	tristate "pod_pwm"
	default n
	depends on ARMADEUS_FPGA_VIRTUAL_COMPONENTS
	---help---
	  Armadeus driver for virtual pod_pwm component.
	  kernel >= 2.6.38 is required
```

## target/linux/modules/fpga/virtual_components/pod_servo/Kconfig
```kconfig
config ARMADEUS_FPGA_VIRTUAL_COMPONENTS_SERVO
	tristate "pod_servo"
	default n
	depends on ARMADEUS_FPGA_VIRTUAL_COMPONENTS
	---help---
	  Armadeus driver for virtual pod_servo component.
	  kernel >= 2.6.38 is required
```

## target/linux/modules/fpga/virtual_components/sploader/Kconfig
```kconfig
config ARMADEUS_FPGA_VIRTUAL_SPVISION_LOADER
	tristate "sploader"
	default n
	depends on ARMADEUS_FPGA_VIRTUAL_COMPONENTS
	---help---
	  With this driver you will be able to (re)load the
	  configuration of your SP_VISION FPGA directly from
	  Linux userspace
```

## target/linux/modules/imx_counter/Kconfig
```kconfig
#
#

config MX27_GPT2
	tristate "Use i.MX27 timer 2 as counter"
	---help---
	  TBD.
```

## target/linux/modules/mxs_lradc/Kconfig
```kconfig
#
#

config ARMADEUS_SENSOR_MXS_LRADC
	tristate "MXS LRADC"
	default n
	depends on ARMADEUS_DRIVERS && MXS_LRADC && HWMON
	---help---
	  Use MXS LRADC as generic hardware monitor device.
```

## target/linux/modules/pwm/Kconfig
```kconfig
#
#

config ARMADEUS_PWM_DRIVER
        tristate "Armadeus PWM driver"
        default n
        depends on ARMADEUS_DRIVERS
        ---help---
	  This driver allows you to control the PWM controller in the i.MXl.
	  PWM is useful to play sound or control motors

config ARMADEUS_MXS_PWM_DRIVER
        tristate "MXS PWM driver"
        default n
        depends on ARMADEUS_DRIVERS
        ---help---
	  This driver allows you to control the MXS PWM controller.
```
